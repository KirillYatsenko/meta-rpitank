## conf/layer.conf
```bitbake
# We have a conf and classes directory, add to BBPATH
BBPATH .= ":${LAYERDIR}"

# We have recipes-* directories, add to BBFILES
BBFILES += "${LAYERDIR}/recipes-*/*/*.bb \
            ${LAYERDIR}/recipes-*/*/*.bbappend"

BBFILE_COLLECTIONS += "meta-rpitank"
BBFILE_PATTERN_meta-rpitank = "^${LAYERDIR}/"
BBFILE_PRIORITY_meta-rpitank = "6"

LAYERDEPENDS_meta-rpitank = "core"
LAYERSERIES_COMPAT_meta-rpitank = "kirkstone"
```
